// This file was generated from a template. Edit it to match your keyboard.
// See https://zmk.dev/docs/development/hardware-integration/new-shield for more
// instructions.

#include <dt-bindings/zmk/matrix_transform.h>

#include "k412-layouts.dtsi"

/ {
    chosen {
        zmk,physical-layout = &default_layout;
    };

    kscan: kscan {
        // If the hardware does not use a switch matrix, change this to the
        // appropriate driver and update the properties below to match.
        // See https://zmk.dev/docs/config/kscan for supported key scan drivers.
        compatible = "zmk,kscan-gpio-matrix";
        // Set this to "col2row" or "row2col" to match the hardware. If using
        // "row2col", change the col-gpios to (GPIO_ACTIVE_HIGH | GPIO_PULL_DOWN)
        // and the row-gpios to GPIO_ACTIVE_HIGH.
        diode-direction = "col2row";
        wakeup-source;

        // Replace these comments with the GPIO pins in the matrix.
        // See https://zmk.dev/docs/development/hardware-integration/new-shield#shield-overlays
        col-gpios
            = <&pro_micro 1 GPIO_ACTIVE_HIGH> // col 1
            , <&pro_micro 2 GPIO_ACTIVE_HIGH> // col 2
            , <&pro_micro 3 GPIO_ACTIVE_HIGH> // col 3
            , <&pro_micro 4 GPIO_ACTIVE_HIGH> // col 4
            , <&pro_micro 5 GPIO_ACTIVE_HIGH> // col 5
            , <&pro_micro 6 GPIO_ACTIVE_HIGH> // col 6
            , <&pro_micro 7 GPIO_ACTIVE_HIGH> // col 7
            , <&pro_micro 8 GPIO_ACTIVE_HIGH> // col 8
            , <&pro_micro 9 GPIO_ACTIVE_HIGH> // col 9
            , <&pro_micro 10 GPIO_ACTIVE_HIGH> // col 0
            , <&pro_micro 14 GPIO_ACTIVE_HIGH> // col 0
            , <&pro_micro 15 GPIO_ACTIVE_HIGH> // col 0
            ;

        row-gpios
            = <&pro_micro 18 (GPIO_ACTIVE_HIGH | GPIO_PULL_DOWN)> // row 1
            , <&pro_micro 19 (GPIO_ACTIVE_HIGH | GPIO_PULL_DOWN)> // row 2
            , <&pro_micro 20 (GPIO_ACTIVE_HIGH | GPIO_PULL_DOWN)> // row 3
            , <&pro_micro 21 (GPIO_ACTIVE_HIGH | GPIO_PULL_DOWN)> // row 4
            ;
    };
};
